#include <LPC23xx.H> /* Описание LPC24xx */


void delay(void) 
{
	unsigned int i;
	for (i=0;i<0xfffff;i++){}
}

/*
. Устройство управления котлом отопления, состоящее из клапана подачи
газа, устройства зажигания, насоса. Программа функционирования:
	a) подача газа и зажигание;
	b) подача газа и работа насоса;
	c) при нажатии на кнопку: прекращение работы насоса и подачи газа.
*/

int main(void)
{
	//Конфигурировать функции входов/выходов порта 0 на модуль GPIO
	PINSEL0 = 0x00000000;
//IODIR0 - Регистр направления ввода вывода (1 - вывод; 0 - ввод)
	IODIR0 = 0xFFFFFFF8; /* P0. ввод 1.2 на вывод */
//IOSET0 - Регистр установки порта (1 - установка; 0 - нет изменений)
	IOSET0 = 0xFFFFFFF8; /* Устанавливаем высокий уровень на выходах */
	
	
	
	
	/* P0 кнопка выключения  P1 клапана подачи газа P2  устройство зажигания P3 насос */
	/*00000...p3p2p1p0
	
	 0 0  -
	 0 1 p1 p2 p2 p3 
	 1 0 p3 p1 
	 1 1 - 
	 
	 
	 
	 0 0 0
	 0 1 1
	 1 0 1
	 1 1 0
*/
	unsigned long int prev = 0;
	while (1)
	{
		if ((IOPIN0 & 0x01) ^ prev)
		{
			
			prev =  IOPIN0 & 0x001; // сохранить предыдущее значение
			
			if ( IOPIN0 & 0x01)
			{
				// включить утсройство зажигания
				// включить клапан полачи газа 
				IOCLR0 = 0x006;
				// delay
				delay();
				// выключить устройство зажигания
				IOSET0 = 0x002; // 0010
				// включить насос 
				IOCLR0 = 0x0C;// 1100
				
			}
			else 
			{
				// выключить газ 
				IOSET0 = 0x02;
				// delay
				delay();
				// выключить насос 
				IOSET0 = 0x08
			}
			
		}
	}
}

/*
Устройство управления камерой слежения, состоящее из двигателя
горизонтального поворота, двигателя вертикального поворота и
устройства включения камеры. Программа функционирования:
a) горизонтальный поворот и съемка.
b) при нажатии на кнопку: поворот.
*/

	


int main1 (void) {
 unsigned int n;
//Конфигурировать функции входов/выходов порта 0 на модуль GPIO
 PINSEL0 = 0x00000000;
//IODIR0 - Регистр направления ввода вывода (1 - вывод; 0 - ввод)
 IODIR0 = 0x00038000; /* P0.15..17 программируем на вывод, остальные на ввод */
//IOSET0 - Регистр установки порта (1 - установка; 0 - нет изменений)
 IOSET0 = 0x00038000; /* Устанавливаем высокий уровень на выходах (гасим
светодиоды) */
 while (1) { /* Бесконечный цикл */
//Если PORT0.10=0 то влево, иначе вправо
 if (IOPIN0 & 0x400) {
 for (n = 0x00008000; n <= 0x00020000; n <<= 1) {
//Бегущая единица
//IOCLR0 - Регистр сброса порта (1 - сброс; 0 - нет изменения)
 IOCLR0 = n; /* Сбросить порт */
 delay(); /* Задержка */
/* То же, что IOSET0 - Установить состояние порта */
 *((volatile unsigned long *) 0xE0028004) = 0x00038000;
}
 }
else {
 for (n = 0x00020000; n >= 0x00008000; n >>= 1) {
//Бегущая единица
 IOCLR0 = n; /* Сбросить порт */
 delay(); /* Задержка */
/* Установить состояние порта */
 IOSET0 = 0x00038000;
}
}
 }
}